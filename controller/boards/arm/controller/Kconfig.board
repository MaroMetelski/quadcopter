## controller/boards/arm/controller/Kconfig.board
```kconfig
# NUCLEO-64 F303RE board configuration

# Copyright (c) 2020 Paul M. Bendixen
# SPDX-License-Identifier: Apache-2.0

config BOARD_CONTROLLER
	bool "Flight controller F3 V1"
	depends on SOC_STM32F303XE
```

## controller/boards/arm/controller/Kconfig.defconfig
```kconfig
if BOARD_CONTROLLER

config BOARD
	default "controller"

endif # BOARD_CONTROLLER
```

## controller/boards/arm/controller/controller_defconfig
```kconfig
CONFIG_SOC_SERIES_STM32F3X=y
CONFIG_SOC_STM32F303XE=y

CONFIG_SERIAL=y

# Enable MPU
CONFIG_ARM_MPU=y

# Enable HW stack protection
CONFIG_HW_STACK_PROTECTION=y

# console
CONFIG_CONSOLE=y
CONFIG_UART_CONSOLE=y

# enable GPIO
CONFIG_GPIO=y

# Enable Clocks
CONFIG_CLOCK_CONTROL=y

# enable pin controller
CONFIG_PINCTRL=y

# enable I2C
CONFIG_I2C=y

# enable SPI
CONFIG_SPI=y

# PWM
CONFIG_PWM=y
```

## controller/drivers/Kconfig
```kconfig
menu "Drivers"

config PWM_MOTORS_DRV
    bool "Zephyr PWM motors driver"
    default y
    depends on PWM && DT_HAS_PWM_MOTORS_ENABLED
    help
      Enable PWM motors driver for pwm-motors compatible.

endmenu
```

## controller/dts/bindings/pwm-inputs.yaml
```yaml
description: PWM inputs parent note

compatible: "pwm-inputs"

child-binding:
  description: PWM input child node
  properties:
    pwms:
      required: true
      type: phandle-array

    label:
      type: string
      description: |
        Human readable string describing the PWM Input. It can be used by an
        application to identify this input or to retrieve its number/index
        (i.e. child node number) on the parent device.
```

## controller/dts/bindings/pwm-motors.yaml
```yaml
description: PWM motors parent note

compatible: "pwm-motors"

child-binding:
  description: PWM motor child node
  properties:
    pwms:
      required: true
      type: phandle-array

    label:
      type: string
      description: |
        Human readable string describing the PWM Motor. It can be used by an
        application to identify this input or to retrieve its number/index
        (i.e. child node number) on the parent device.
```
