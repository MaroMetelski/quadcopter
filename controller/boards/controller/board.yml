## controller/boards/controller/board.yml
```yaml
board:
  name: controller
  full_name: Controller
  vendor: custom
  socs:
    - name: stm32f303xe
```

## controller/west.yml
```yaml
manifest:
  defaults:
    remote: zephyrproject-rtos
  remotes:
    - name: zephyrproject-rtos
      url-base: https://github.com/zephyrproject-rtos

  projects:
    - name: zephyr
      revision: v4.4.0
      path: zephyr
      import:
        name-allowlist:
          - cmsis
          - cmsis-dsp
          - cmsis_6
          - hal_stm32
          - hal_st # for st device drivers, like lsm6dso
          - net-tools # native sim tools
      west-commands: scripts/west-commands.yml
```
